## conf/bblayers.conf
```bitbake
# POKY_BBLAYERS_CONF_VERSION is increased each time build/conf/bblayers.conf
# changes incompatibly
POKY_BBLAYERS_CONF_VERSION = "2"

BBPATH = "${TOPDIR}"
BBFILES ?= ""

BBLAYERS ?= " \
  ${TOPDIR}/../poky-source/meta \
  ${TOPDIR}/../poky-source/meta-poky \
  ${TOPDIR}/../poky-source/meta-yocto-bsp \
  ${TOPDIR}/../meta-openembedded/meta-oe \
  ${TOPDIR}/../meta-openembedded/meta-multimedia \
  ${TOPDIR}/../meta-openembedded/meta-networking \
  ${TOPDIR}/../meta-openembedded/meta-python \
  ${TOPDIR}/../meta-openembedded/meta-filesystems \
  ${TOPDIR}/../meta-qt6 \
  ${TOPDIR}/../meta-raspberrypi \
  ${TOPDIR}/../meta-defender \
  "
```

## conf/local.conf
```bitbake
# Local configuration for Defender Automotive builds

MACHINE ?= "raspberrypi4"
DISTRO ?= "poky"
PACKAGE_CLASSES ?= "package_rpm"
EXTRA_IMAGE_FEATURES ?= "debug-tweaks"
USER_CLASSES ?= "buildstats"
PATCHRESOLVE = "noop"

# Use systemd as init system
DISTRO_FEATURES_append = " systemd wayland pam"
DISTRO_FEATURES_remove = "x11 sysvinit"
VIRTUAL-RUNTIME_init_manager = "systemd"
VIRTUAL-RUNTIME_initscripts = ""

# Enable multilib support to run 32-bit binaries if needed
require conf/multilib.conf
MULTILIBS = "multilib:lib32"
DEFAULTTUNE_virtclass-multilib-lib32 = "armv7athf-neon"

# Use Qt6 for UI
PREFERRED_PROVIDER_virtual/libgl = "mesa"
PREFERRED_PROVIDER_virtual/egl = "mesa"

# Add Qt6 settings
PACKAGECONFIG_append_pn-qtbase = " gles2 eglfs fontconfig"

# Disk space management
BB_DISKMON_DIRS ??= "\
    STOPTASKS,${TMPDIR},1G,100K \
    STOPTASKS,${DL_DIR},1G,100K \
    STOPTASKS,${SSTATE_DIR},1G,100K \
    STOPTASKS,/tmp,100M,100K \
    ABORT,${TMPDIR},100M,1K \
    ABORT,${DL_DIR},100M,1K \
    ABORT,${SSTATE_DIR},100M,1K \
    ABORT,/tmp,10M,1K"

# Build with multiple cores
BB_NUMBER_THREADS ?= "4"
PARALLEL_MAKE ?= "-j 4"

# Download location
DL_DIR ?= "${TOPDIR}/downloads"

# Shared state files location
SSTATE_DIR ?= "${TOPDIR}/sstate-cache"

# Package feed settings
PACKAGE_FEED_URIS = "http://feeds.defender-automotive.com"
PACKAGE_FEED_BASE_PATHS = "rpm"
PACKAGE_FEED_ARCHS = "all ${MACHINE} ${TUNE_PKGARCH}"

# SDK settings for development
SDKMACHINE ?= "x86_64"

# Add automotive-specific packages
CORE_IMAGE_EXTRA_INSTALL += "defender-dashboard defender-carplay defender-launcher defender-settings"

# Enable debug features during development
EXTRA_IMAGE_FEATURES += "debug-tweaks ssh-server-openssh tools-debug tools-sdk"

# Enable network configuration
INHERIT += "extrausers"
EXTRA_USERS_PARAMS = "usermod -P defender root;"

# Reduce build tasks
INHERIT += "rm_work"
```

## meta-defender/conf/layer.conf
```bitbake
# We have a conf and classes directory, add to BBPATH
BBPATH .= ":${LAYERDIR}"

# We have recipes-* directories, add to BBFILES
BBFILES += "${LAYERDIR}/recipes-*/*/*.bb \
            ${LAYERDIR}/recipes-*/*/*.bbappend"

BBFILE_COLLECTIONS += "defender"
BBFILE_PATTERN_defender = "^${LAYERDIR}/"
BBFILE_PRIORITY_defender = "10"

LAYERDEPENDS_defender = "core qt6-layer openembedded-layer"
LAYERSERIES_COMPAT_defender = "kirkstone"
```

## meta-defender/conf/machine/defender-automotive.conf
```bitbake
#@TYPE: Machine
#@NAME: defender-automotive
#@DESCRIPTION: Machine configuration for Defender Automotive in-car entertainment system

require conf/machine/include/qemu.inc
DEFAULTTUNE ?= "cortexa57"
require conf/machine/include/arm/armv8a/tune-cortexa57.inc

PREFERRED_PROVIDER_virtual/kernel ?= "linux-yocto"
PREFERRED_VERSION_linux-yocto ?= "5.15%"

MACHINE_FEATURES = "apm usbgadget usbhost vfat alsa touchscreen keyboard bluetooth wifi"

KERNEL_DEVICETREE = "qcom/sc7180-trogdor-lazor-r0.dtb"

SERIAL_CONSOLES = "115200;ttyS0"

# Use wayland/weston as the default compositor
DISTRO_FEATURES_append = " wayland"
DISTRO_FEATURES_remove = "x11"

# Qt related configurations
PACKAGECONFIG_append_pn-qtbase = " eglfs kms"

# Default to 2GB RAM for qemu
QB_MEM = "-m 2048"

IMAGE_FSTYPES += "tar.bz2 wic.bz2 wic.bmap"
WKS_FILE ?= "defender-automotive.wks"

# Boot with systemd
DISTRO_FEATURES_append = " systemd"
VIRTUAL-RUNTIME_init_manager = "systemd"
VIRTUAL-RUNTIME_initscripts = ""

PREFERRED_PROVIDER_virtual/egl = "mesa"
PREFERRED_PROVIDER_virtual/libgl = "mesa"
PREFERRED_PROVIDER_virtual/libgles1 = "mesa"
PREFERRED_PROVIDER_virtual/libgles2 = "mesa"

# This sets preferences for CarPlay support
PREFERRED_PROVIDER_virtual/libomxil = "libomxil"

# Include kernel modules needed for automotive features
MACHINE_ESSENTIAL_EXTRA_RDEPENDS += "kernel-modules"
```

## meta-defender/wic/defender-automotive.wks
```
# short-description: Create a Defender Automotive image with boot and root partitions
# long-description: Creates a partitioned image with boot and root partitions.
# Boot files are located in the first vfat partition.

part /boot --source bootimg-partition --ondisk sda --fstype=vfat --label boot --active --align 4 --size 16 --sourceparams="loader=u-boot" --use-uuid
part / --source rootfs --ondisk sda --fstype=ext4 --label root --align 4 --use-uuid

bootloader --ptable gpt
```
